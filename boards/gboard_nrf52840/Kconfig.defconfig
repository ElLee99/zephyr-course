## boards/gboard_nrf52840/board.yml
```yaml
board:
  name: gboard
  full_name: Garcia Custom Board nRF52840
  vendor: Garcia
  socs:
  - name: nrf52840
```

## boards/jboard_nrf52840/Kconfig.jboard
```kconfig
# Copyright (c) 2022 Zephyr Project members and individual contributors
# SPDX-License-Identifier: Apache-2.0

config BOARD_JBOARD
	select SOC_NRF52840_QIAA if BOARD_JBOARD
	select SOC_NRF52811_QFAA if BOARD_NRF52840DK_NRF52811
```

## boards/jboard_nrf52840/board.yml
```yaml
board:
  name: jboard
  full_name: Johan Custom Board nRF52840
  vendor: Johan
  socs:
  # Physical nRF52840 SoC on PCA10056
  - name: nrf52840
  # nRF52840 SoC in nRF52811 emulation mode on PCA10056
  - name: nrf52811
```

## drivers/led_sensor/Kconfig
```kconfig
menuconfig LED_SENSOR
    bool "LED Sensor Driver"
    default y
    depends on GPIO
```

## dts/bindings/johan,led-sensor.yaml
```yaml
description: Fake LED sensor driver

compatible: "johan,led-sensor"

include: base.yaml

properties:
  led-gpios:
    type: phandle-array
    required: true
```
